#include <Arduboy2.h> 

Arduboy2 arduboy;
Sprites sprites;

const byte PROGMEM ball[] = {
  16, 16, 
  0xE0, 0xF8, 0xFC, 0xFE, 0xFE, 0xFF, 0xFF, 0xFF, 0xFF, 0xFF, 0xFF, 0x3E, 0x3E, 0xFC, 0xF8, 0xE0,
  0x07, 0x1F, 0x3F, 0x7F, 0x7F, 0xFF, 0xFF, 0xDF, 0xDF, 0xCF, 0xE7, 0x63, 0x7B, 0x3F, 0x1F, 0x07,
};

const byte PROGMEM ball_externalMask[] = {
  0xFF, 0xFF, 0xFF, 0xFF, 0xFF, 0xFF, 0xFF, 0xFF, 0x00, 0x00, 0x00, 0x00, 0x00, 0x00, 0x00, 0x00,
  0x00, 0x00, 0x00, 0x00, 0x00, 0x00, 0x00, 0x00, 0xFF, 0xFF, 0xFF, 0xFF, 0xFF, 0xFF, 0xFF, 0xFF,
};

const byte PROGMEM ball_plusMask[] = {
  16, 16, 

  0xE0, 0xFF, 0xF8, 0xFF, 0xFC, 0xFF, 0xFE, 0xFF, 0xFE, 0xFF, 0xFF, 0xFF, 0xFF, 0xFF, 0xFF, 0xFF, 
  0xFF, 0x00, 0xFF, 0x00, 0xFF, 0x00, 0x3E, 0x00, 0x3E, 0x00, 0xFC, 0x00, 0xF8, 0x00, 0xE0, 0x00, 
  0x07, 0x00, 0x1F, 0x00, 0x3F, 0x00, 0x7F, 0x00, 0x7F, 0x00, 0xFF, 0x00, 0xFF, 0x00, 0xDF, 0x00, 
  0xDF, 0xFF, 0xCF, 0xFF, 0xE7, 0xFF, 0x63, 0xFF, 0x7B, 0xFF, 0x3F, 0xFF, 0x1F, 0xFF, 0x07, 0xFF, 

};

int x = 0;
bool fwd = true;

void setup() {
 
  arduboy.begin();
  arduboy.clear();

}

void loop() {

  arduboy.clear();

  // Draw background ..
  for (int y = 0; y < 256; y+=4) {
    arduboy.drawLine(y, 0, 0, y, WHITE);
  }
  arduboy.fillRect(0, 0, 64, 64, BLACK);


  // Move the ball ..
   
  if (fwd) {
    x+=2;
    if (x == 112) fwd = false;
  }
  else {
    x-=2;
    if (x==0) fwd = true;
  }

  

  sprites.drawOverwrite(x,  24, ball, 0);
//sprites.drawErase(x,  24, ball, 0);
//sprites.drawSelfMasked(x,  24, ball, 0);
//sprites.drawPlusMask(x,  24, ball_plusMask, 0);
//sprites.drawExternalMask(x,  24, ball, ball_externalMask, 0, 0);
  arduboy.display();

}
